## main/Kconfig.projbuild
```kconfig
menu "My App Configuration"
    config MY_APP_VERSION
        string "Application Version"
        default "1.0.0"
        help
            Version string of the application

    menu "LED Configuration"
        config MY_APP_LED_GPIO
            int "LED GPIO Pin"
            default 2
            help
                GPIO pin number for LED control

        config MY_APP_LED_ACTIVE_LEVEL
            bool "LED Active Level (1=HIGH, 0=LOW)"
            default y
            help
                Set LED active level. High (1) or Low (0)
    endmenu

    menu "UART GPS Configuration"
        config GPS_APP_UART_PORT
            int "UART Port Number"
            default 1
            help
                UART port number (0=UART0, 1=UART1, etc)

        config GPS_APP_UART_BAUD_RATE
            int "UART Baud Rate"
            default 115200
            help
                UART communication baud rate

        config GPS_APP_UART_TX_PIN
            int "UART TX GPIO Pin"
            default 21
            help
                GPIO pin number for UART TX

        config GPS_APP_UART_RX_PIN
            int "UART RX GPIO Pin"
            default 22
            help
                GPIO pin number for UART RX
    endmenu
    menu "UART Modbus Configuration"
        config MODBUS_APP_UART_PORT
            int "UART Port Number"
            default 2
            help
                UART port number (0=UART0, 1=UART1, etc)

        config MODBUS_APP_UART_BAUD_RATE
            int "UART Baud Rate"
            default 9600
            help
                UART communication baud rate

        config MODBUS_APP_UART_TX_PIN
            int "UART TX GPIO Pin"
            default 17
            help
                GPIO pin number for UART TX

        config MODBUS_APP_UART_RX_PIN
            int "UART RX GPIO Pin"
            default 16
            help
                GPIO pin number for UART RX
        endmenu
    menu "WiFi Configuration"
        config ESP_WIFI_SSID
        string "WiFi SSID"
        default "myssid"
        help
            SSID (network name) for the example to connect to.

        config ESP_WIFI_PASSWORD
            string "WiFi Password"
            default "mypassword"
            help
                WiFi password (WPA or WPA2) for the example to use.

        choice ESP_WIFI_SAE_MODE
            prompt "WPA3 SAE mode selection"
            default ESP_STATION_EXAMPLE_WPA3_SAE_PWE_BOTH
            help
                Select mode for SAE as Hunt and Peck, H2E or both.
            config ESP_STATION_EXAMPLE_WPA3_SAE_PWE_HUNT_AND_PECK
                bool "HUNT AND PECK"
            config ESP_STATION_EXAMPLE_WPA3_SAE_PWE_HASH_TO_ELEMENT
                bool "H2E"
                depends on ESP_WIFI_ENABLE_SAE_H2E
            config ESP_STATION_EXAMPLE_WPA3_SAE_PWE_BOTH
                bool "BOTH"
                depends on ESP_WIFI_ENABLE_SAE_H2E
        endchoice

        config ESP_WIFI_PW_ID
            string "PASSWORD IDENTIFIER"
            depends on  ESP_STATION_EXAMPLE_WPA3_SAE_PWE_HASH_TO_ELEMENT|| ESP_STATION_EXAMPLE_WPA3_SAE_PWE_BOTH
            default ""
            help
                password identifier for SAE H2E

        config ESP_MAXIMUM_RETRY
            int "Maximum retry"
            default 5
            help
                Set the Maximum retry to avoid station reconnecting to the AP unlimited when the AP is really inexistent.

        choice ESP_WIFI_SCAN_AUTH_MODE_THRESHOLD
            prompt "WiFi Scan auth mode threshold"
            default ESP_WIFI_AUTH_WPA2_PSK
            help
                The weakest authmode to accept in the scan mode.
                This value defaults to ESP_WIFI_AUTH_WPA2_PSK in case password is present and ESP_WIFI_AUTH_OPEN is used.
                Please select ESP_WIFI_AUTH_WEP/ESP_WIFI_AUTH_WPA_PSK in case AP is operating in WEP/WPA mode.

            config ESP_WIFI_AUTH_OPEN
                bool "OPEN"
            config ESP_WIFI_AUTH_WEP
                bool "WEP"
            config ESP_WIFI_AUTH_WPA_PSK
                bool "WPA PSK"
            config ESP_WIFI_AUTH_WPA2_PSK
                bool "WPA2 PSK"
            config ESP_WIFI_AUTH_WPA_WPA2_PSK
                bool "WPA/WPA2 PSK"
            config ESP_WIFI_AUTH_WPA3_PSK
                bool "WPA3 PSK"
            config ESP_WIFI_AUTH_WPA2_WPA3_PSK
                bool "WPA2/WPA3 PSK"
            config ESP_WIFI_AUTH_WAPI_PSK
                bool "WAPI PSK"
        endchoice
     endmenu    
endmenu
```
